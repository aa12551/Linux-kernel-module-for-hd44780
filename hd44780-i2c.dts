/dts-v1/;
/plugin/;
/ {
	compatible = "brcm,bcm2835";
	fragment@0 {
		target = <&i2c1>;
		__overlay__ {
			#address-cells = <1>;
			#size-cells = <0>;

			hd44780-i2c@27 {
				compatible = "hd44780";
				reg = <0x27>;
			};
		};
	};
};
